## boards/shields/xbows_crystal/Kconfig.defconfig
```kconfig
# Copyright (c) 2023 The ZMK Contributors
# SPDX-License-Identifier: MIT

if SHIELD_XBOWS_CRYSTAL

config ZMK_KEYBOARD_NAME
    default "X-Bows Crystal"

endif
```

## boards/shields/xbows_crystal/Kconfig.shield
```kconfig
# Copyright (c) 2023 The ZMK Contributors
# SPDX-License-Identifier: MIT

config SHIELD_XBOWS_CRYSTAL
    def_bool $(shields_list_contains,xbows_crystal)
```
